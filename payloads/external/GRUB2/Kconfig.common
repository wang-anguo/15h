## payloads/external/GRUB2/Kconfig.common
```kconfig
config GRUB2_REVISION_ID
	string "Insert a commit's SHA-1 or a branch name"
	depends on (GRUB2_REVISION||GRUB2_SECONDARY_REVISION)
	default "origin/master"
	help
	   The commit's SHA-1 or branch name of the revision to use.

config GRUB2_EXTRA_MODULES
	string "Extra modules to include in GRUB image"
	depends on !GRUB2_FLOPPY
	help
	  Space-separated list of additional modules to include. Few common
	  ones:
	  * bsd for *BSD
	  * png/jpg for PNG/JPG images
	  * gfxmenu for graphical menus (you'll need a theme as well)
	  * gfxterm_background for setting background

config GRUB2_MODULES
	string "Modules to include in GRUB image"
	depends on GRUB2_FLOPPY
	help
	  Space-separated list of additional modules to include. Few common
	  ones:
	  * bsd for *BSD
	  * png/jpg for PNG/JPG images
	  * gfxmenu for graphical menus (you'll need a theme as well)
	  * gfxterm_background for setting background

config GRUB2_INCLUDE_RUNTIME_CONFIG_FILE
	bool "Include GRUB2 runtime config file into ROM image"
	depends on (PAYLOAD_GRUB2 || GRUB2_SECONDARY_PAYLOAD) && (!GRUB2_FLOPPY)
	default n
	help
	  The GRUB2 payload reads its runtime configuration file from etc/grub.cfg
	  stored in the CBFS on the flash ROM chip. Without that, it’ll just drop
	  into a rescue shell.

	  This configuration may need to be coreboot specific.

	  Select this option, if you want to include the GRUB2 runtime
	  configuration file into CBFS as `etc/grub.cfg` automatically.

	  You will be able to specify the path of the configuration file later.

	  Without this option you would need to add this file manually with
	  build/cbfstool build/coreboot.rom add -f grub.cfg -n etc/grub.cfg -t raw

config GRUB2_RUNTIME_CONFIG_FILE
	string "Path of grub.cfg"
	depends on GRUB2_INCLUDE_RUNTIME_CONFIG_FILE
	default "grub.cfg"
	help
	  The path of the GRUB2 runtime configuration file to be added to CBFS.

config GRUB2_FLOPPY_FDROOT
	string "Path of fdroot to include in GRUB image"
	depends on GRUB2_SECONDARY_PAYLOAD && GRUB2_FLOPPY
	help
	  The GRUB2 floppy has its own filesystem (fdroot).

	  The grub.cfg file should be placed at:

	  	(fdroot)/boot/grub/grub.cfg

	  Within GRUB2, the path to this file will be:
	  	
		(fd0)/boot/grub/grub.cfg
```

## payloads/external/GRUB2/Kconfig.secondary
```kconfig
if GRUB2_SECONDARY_PAYLOAD

choice
	prompt "GRUB2 version"
	default GRUB2_SECONDARY_STABLE

config GRUB2_SECONDARY_STABLE
	bool "2.02"
	help
	  Stable GRUB2 version

config GRUB2_SECONDARY_MASTER
	bool "HEAD"
	help
	  Newest GRUB2 version

config GRUB2_SECONDARY_REVISION
	bool "git revision"
	help
	  Select this option if you have a specific commit or branch
	  that you want to use as the revision from which to
	  build GRUB2.

	  You will be able to specify the name of a branch or a commit id
	  later.
endchoice

config GRUB2_FLOPPY
	bool "Add GRUB2 as a SeaBIOS Floppy image"
	depends on PAYLOAD_SEABIOS
	default y

source "payloads/external/GRUB2/Kconfig.common"

endif
```

## src/mainboard/asus/kcma-d8/Kconfig
```kconfig
if BOARD_ASUS_KCMA_D8

config BOARD_SPECIFIC_OPTIONS
	def_bool y
	select AGESA_LEGACY
	select CPU_AMD_AGESA_FAMILY15
	select CPU_AMD_SOCKET_G34
	select NORTHBRIDGE_AMD_AGESA_FAMILY15
	select NORTHBRIDGE_AMD_CIMX_RD890
	select SOUTHBRIDGE_AMD_CIMX_SB700
	select SUPERIO_WINBOND_W83667HG_A
	select DRIVERS_I2C_W83795
	select DRIVERS_ASPEED_AST2050
	select BOARD_ROMSIZE_KB_2048
	select MAINBOARD_FORCE_NATIVE_VGA_INIT
	select HAVE_OPTION_TABLE
	select HAVE_PIRQ_TABLE
	select HAVE_MP_TABLE
	select HAVE_ACPI_TABLES

config MAINBOARD_DIR
	string
	default "asus/kcma-d8"

config MAINBOARD_PART_NUMBER
	string
	default "KCMA-D8"

config DEVICETREE
	string
	default "devicetree.cb"

config HW_MEM_HOLE_SIZEK
	hex
	default 0x100000

config MAX_CPUS
	int
	default 32

config IRQ_SLOT_COUNT
	int
	default 13

config ONBOARD_VGA_IS_PRIMARY
	bool
	default y

config VGA_BIOS
	bool
	default n

config VGA_BIOS_ID
	string
	default "1a03,2000"

config VGA_BIOS_FILE
	string
	default "3rdparty/blobs/mainboard/asus/kcma-d8/VGABIOS.bin"

endif # BOARD_ASUS_KCMA_D8
```

## src/mainboard/supermicro/h8dgi/Kconfig.name
```kconfig
config BOARD_SUPERMICRO_H8DGI
	bool "H8DGi"

config BOARD_SUPERMICRO_H8DG6
	bool "H8DG6"
```

## src/mainboard/supermicro/h8qgi/Kconfig.name
```kconfig
config BOARD_SUPERMICRO_H8QGI_PM_F
	bool "H8QGi+-F"

config BOARD_SUPERMICRO_H8QG6_PM_F
	bool "H8QG6+-F"
```
